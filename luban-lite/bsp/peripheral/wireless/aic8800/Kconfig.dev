## luban-lite/bsp/peripheral/wireless/aic8800/Kconfig.dev
```kconfig
#-----------------------------
# aic8800 wlan devices local parameter
#-----------------------------

# wlan0 parameter

menu "Wlan0 Parameter"

    choice
        prompt "Select AIC8800 MODEL"
        default CHIP_SELECT_AIC8800D40L
        config CHIP_SELECT_AIC8800D40L
            bool "select AIC8800D40L"
        config CHIP_SELECT_AIC8800DW
            bool "select AIC8800DW"
    endchoice

    choice
        prompt "Select AIC8800 power converter"
        default CONFIG_AIC8800_VRF_DCDC_MODE
        config CONFIG_AIC8800_VRF_DCDC_MODE
            bool "select DCDC mode"
        config CONFIG_AIC8800_VRF_LDO_MODE
            bool "select LDO mode"
    endchoice

    choice
        prompt "Select AIC8800 work mode"
        default CONFIG_AIC8800_NORMAL_MODE
        config CONFIG_AIC8800_NORMAL_MODE
            bool "select normal mode"
        config CONFIG_AIC8800_RFTEST_MODE
            bool "select rftest mode"
    endchoice

    config AIC_WLAN_AP_BW_40M
        bool "Access point channel width 40 MHz (default 20 MHz)"
        default n
        help
          The soft AP is started with a 20 MHz channel. 40 MHz roughly doubles the PHY rate but needs a clean
          band: try it on a 5 GHz channel (`wifi ap SSID PASSWORD 36`) once that works. The channel itself is
          chosen at run time: `wifi ap SSID PASSWORD CHANNEL`, channel >= 36 is 5 GHz.

    config CONFIG_AIC8800_BT_SUPPORT
        bool "enable aic8800 BT support"
        default n

    config AIC_DEV_AIC8800_BT_RST_GPIO
        string "aic8800 bt reset gpio"

    config AIC_WIRELESS_PWR_GPIO
        string "aic8800 wlan0 power on gpio"

    config AIC_DEV_AIC8800_WLAN0_RST_GPIO
        string "aic8800 wlan0 reset gpio"

    config AIC_DEV_AIC8800_DEBUG_LOG
        bool "enable aic8800 debug messages"
        default y

endmenu
```

## luban-lite/packages/third-party/agile_ftp/Kconfig
```kconfig
# agile_ftp: lightweight FTP server (https://github.com/loogg/agile_ftp)
menuconfig LPKG_USING_AGILE_FTP
    bool "agile_ftp: FTP server over SAL socket + DFS"
    depends on RT_USING_SAL && SAL_USING_POSIX && RT_USING_DFS
    default n

if LPKG_USING_AGILE_FTP
    config FTP_MAX_SESSION_NUM
        int "Max FTP client sessions"
        default 4

    config FTP_SESSION_USERNAME
        string "FTP username"
        default "adas"

    config FTP_SESSION_PASSWORD
        string "FTP password"
        default "adas"

    config AGILE_FTP_AUTOSTART
        bool "Start FTP server at boot (INIT_APP_EXPORT)"
        default y

    config AGILE_FTP_THREAD_STACK
        int "FTP thread stack size"
        default 4096

    config AGILE_FTP_THREAD_PRIO
        int "FTP thread priority"
        default 20
endif
```

## luban-lite/packages/third-party/dataserver/Kconfig
```kconfig
# dataServer: C port of NikosMav/System-Programming-3 for RT-Thread
menuconfig LPKG_USING_DATASERVER
    bool "dataServer: multi-threaded file server (NikosMav/System-Programming-3 port)"
    depends on RT_USING_POSIX_SOCKET && RT_USING_POSIX_FS && RT_USING_PTHREADS
    default n
    help
      Clients request a directory below DATASERVER_ROOT and receive every
      file in it: path, size, then the data in DATASERVER_BLOCK_SIZE blocks.
      Compatible with the upstream remoteClient and rtthread/remote_client.py.

if LPKG_USING_DATASERVER
    config DATASERVER_PORT
        int "TCP port"
        default 9000

    config DATASERVER_POOL_SIZE
        int "Worker threads (-s)"
        range 1 4
        default 2

    config DATASERVER_QUEUE_SIZE
        int "File queue size (-q)"
        default 16

    config DATASERVER_BLOCK_SIZE
        int "Block size in bytes (-b)"
        range 512 16384
        default 4096

    config DATASERVER_ROOT
        string "Root directory clients may read (-r)"
        default "/data/adas"

    config DATASERVER_THREAD_STACK
        int "Stack size per thread"
        default 8192

    config DATASERVER_AUTOSTART
        bool "Start at boot"
        default y

    config DATASERVER_STAT_PORT
        int "Live stats port for the PC dashboard (0: off)"
        default 9001
        help
          One line of JSON per connection: per-interface byte/packet
          counters of e0/w0/w1 (netmon hooks on lwIP netif input and
          linkoutput) and the dataServer counters. Needs one RT-Thread
          thread (4 KB stack) and one socket. Frames the stack or the driver
          refuse are counted per interface (rx_drop, tx_err).

    config DATASERVER_LWIP_STATS
        bool "Report lwIP drop counters on the stats port (enables RT_LWIP_STATS)"
        depends on DATASERVER_STAT_PORT != 0
        select RT_LWIP_STATS
        default y
        help
          Adds the "lwip" object to the stats line: packets forwarded between
          e0 and w1, drops by layer, buffer pool and tcpip message pool errors,
          and the configured limits (PBUF_POOL_SIZE, MEMP_NUM_TCPIP_MSG_INPKT,
          TCPIP_MBOX_SIZE) those counters are to be read against. Tune the
          limits only after these counters show which one runs out.
endif
```

## luban-lite/target/configs/d13x_demo88-nor_rt-thread_helloworld_defconfig
```kconfig
CONFIG_PRJ_DEFCONFIG_FILENAME="d13x_demo88-nor_rt-thread_helloworld_defconfig"
CONFIG_PRJ_CHIP="d13x"
CONFIG_PRJ_BOARD="demo88-nor"
CONFIG_PRJ_KERNEL="rt-thread"
CONFIG_PRJ_APP="helloworld"
CONFIG_AIC_USING_FS_IMAGE_0=y
CONFIG_AIC_USING_FS_IMAGE_TYPE_FATFS_FOR_0=y
CONFIG_AIC_FS_IMAGE_DIR_0="rodata/"
CONFIG_AIC_FS_IMAGE_NAME_0="rodata.fatfs"
CONFIG_AIC_USING_FS_IMAGE_1=y
CONFIG_AIC_FS_IMAGE_DIR_1="data/"
CONFIG_AIC_FS_IMAGE_NAME_1="data.lfs"
CONFIG_LVGL_V_9=y
CONFIG_LPKG_LVGL_THREAD_STACK_SIZE=32768
CONFIG_AIC_LVGL_DEMO=y
# CONFIG_HCN_D123BBV_DEMO is not set
CONFIG_AIC_LVGL_DEMO_HUB_DEMO=y
CONFIG_LV_COLOR_DEPTH=16
CONFIG_LV_CACHE_IMG_NUM=8
CONFIG_AIC_USING_UART0=y
CONFIG_AIC_USING_I2C2=y
CONFIG_AIC_USING_CAN0=y
CONFIG_AIC_USING_USB0=y
CONFIG_AIC_USING_USB0_HOST=y
CONFIG_AIC_USING_QSPI0=y
CONFIG_AIC_QSPI0_DEVICE_SPINOR=y
CONFIG_AIC_USING_SDMC0=y
CONFIG_AIC_SDMC0_IS_SDIO=y
CONFIG_AIC_SDMC0_CLK_FREQ=40000000
CONFIG_AIC_WIRELESS_LAN=y
CONFIG_AIC_WIRELESS_PWR_GPIO="PD.7"
CONFIG_AIC_WLAN_AIC8800D40L=y
# CONFIG_AIC_DEV_AIC8800_DEBUG_LOG is not set
CONFIG_AIC_USING_TSEN=y
CONFIG_AIC_USING_TSEN_CPU=y
CONFIG_AIC_USING_TSEN_GPAI=y
CONFIG_AIC_USING_GPAI=y
CONFIG_AIC_USING_GPAI7=y
CONFIG_AIC_DISP_LVDS=y
CONFIG_AICFB_RGB565=y
CONFIG_AIC_PAN_DISPLAY=y
# CONFIG_AIC_DISP_BOOTUP_LOGO is not set
CONFIG_AIC_PANEL_ENABLE_GPIO="PE.13"
CONFIG_AIC_GE_CMDQ=y
CONFIG_AIC_USING_AUDIO=y
CONFIG_AIC_AUDIO_PA_ENABLE_GPIO="PD.10"
CONFIG_AIC_AUDIO_EN_PIN_LOW=y
CONFIG_AIC_AUDIO_SPK_1=y
CONFIG_AIC_USING_DMA=y
CONFIG_AIC_USING_WRI=y
CONFIG_AIC_USING_RTC=y
CONFIG_AIC_USING_WDT=y
CONFIG_AIC_PSRAM_SIZE=0x1000000
CONFIG_AIC_PSRAM_SW_SIZE=0x800000
CONFIG_AIC_INTERRUPTSTACK_SIZE=4096
CONFIG_AIC_CLK_PLL_FRA0_FREQ=792000000
CONFIG_AIC_CLK_PLL_FRA2_FREQ=1188000000
CONFIG_AIC_USING_SID=y
CONFIG_AIC_USING_MTOP=y
CONFIG_AIC_USING_PSADC=y
CONFIG_AIC_USING_PSADC6=y
CONFIG_IDLE_THREAD_STACK_SIZE=1024
CONFIG_RT_TIMER_THREAD_PRIO=7
CONFIG_RT_TIMER_THREAD_STACK_SIZE=8192
# CONFIG_RT_KSERVICE_USING_STDLIB is not set
# CONFIG_RT_DEBUG is not set
CONFIG_RT_MEMHEAP_BSET_MODE=y
CONFIG_RT_USING_MEMHEAP_AS_HEAP=y
# CONFIG_RT_USING_MEMHEAP_AUTO_BINDING is not set
CONFIG_RT_CONSOLE_DEVICE_NAME="uart0"
CONFIG_RT_MAIN_THREAD_STACK_SIZE=4096
CONFIG_FINSH_HISTORY_LINES=1
CONFIG_DFS_FILESYSTEMS_MAX=8
CONFIG_RT_USING_DFS_MNTTABLE=y
CONFIG_RT_USING_DFS_ELMFAT=y
CONFIG_RT_DFS_ELM_LFN_UNICODE_2=y
CONFIG_RT_DFS_ELM_USE_EXFAT=y
CONFIG_RT_DFS_ELM_DRIVES=4
CONFIG_RT_DFS_ELM_MAX_SECTOR_SIZE=4096
CONFIG_RT_USING_DFS_ROMFS=y
CONFIG_RT_USING_FAL=y
# CONFIG_FAL_DEBUG_CONFIG is not set
CONFIG_FAL_USING_SFUD_PORT=y
# CONFIG_FAL_BLK_DEVICE_RDONLY is not set
CONFIG_RT_USING_SYSTEM_WORKQUEUE=y
CONFIG_RT_SYSTEM_WORKQUEUE_STACKSIZE=8192
CONFIG_RT_USING_PWM=y
CONFIG_RT_USING_PM=y
CONFIG_PM_USING_CUSTOM_CONFIG=y
CONFIG_PM_ENABLE_SUSPEND_SLEEP_MODE=y
CONFIG_PM_ENABLE_THRESHOLD_SLEEP_MODE=y
CONFIG_RT_SDIO_STACK_SIZE=16384
CONFIG_RT_SDIO_THREAD_PRIORITY=5
CONFIG_RT_MMCSD_STACK_SIZE=8192
CONFIG_RT_SFUD_USING_QSPI=y
CONFIG_RT_USING_TOUCH=y
CONFIG_RT_TOUCH_PIN_IRQ=y
CONFIG_RT_USING_WIFI=y
CONFIG_RT_WLAN_WORKQUEUE_THREAD_SIZE=8192
CONFIG_RT_WLAN_DEBUG=y
CONFIG_RT_WLAN_CMD_DEBUG=y
CONFIG_RT_USING_NETDEV=y
CONFIG_RT_LWIP_TCPTHREAD_PRIORITY=3
CONFIG_RT_LWIP_TCPTHREAD_STACKSIZE=8192
CONFIG_RT_LWIP_REASSEMBLY_FRAG=y
CONFIG_RT_LWIP_NETIF_LOOPBACK=y
CONFIG_RT_USING_ULOG=y
CONFIG_ULOG_OUTPUT_LVL_I=y
CONFIG_ULOG_TIME_USING_TIMESTAMP=y
CONFIG_ULOG_USING_FILTER=y
CONFIG_LPKG_USING_CPU_USAGE=y
CONFIG_LPKG_USING_CHERRYUSB=y
CONFIG_LPKG_CHERRYUSB_HOST=y
CONFIG_LPKG_CHERRYUSB_HOST_MSC=y
CONFIG_LPKG_CHERRYUSB_THIRD_PARTY=y
CONFIG_LPKG_CHERRYUSB_MEMORY_POOL=y
CONFIG_LPKG_CHERRYUSB_RINGBUFFER=y
CONFIG_LPKG_USING_LITTLEFS=y
CONFIG_LPKG_USING_FREETYPE=y
CONFIG_AIC_MPP_PLAYER_INTERFACE=y
CONFIG_AIC_MPP_PLAYER_VIDEO_EXT_RENDER=y
CONFIG_AIC_GPIO_IRQ_DRV_EN=y
CONFIG_AIC_USING_TOUCH=y
CONFIG_AIC_TOUCH_PANEL_I2C_CHAN="i2c2"
CONFIG_AIC_TOUCH_PANEL_RST_PIN="PA.10"
CONFIG_AIC_TOUCH_PANEL_INT_PIN="PA.11"
CONFIG_AIC_BACKTRACE_DEBUG=y
CONFIG_AIC_CMU_DRV_TEST=y
CONFIG_AIC_GPIO_DRV_TEST=y
CONFIG_AIC_DMA_DRV_TEST=y
CONFIG_AIC_CAN_DRV_TEST=y
CONFIG_AIC_AUDIO_DRV_TEST=y
CONFIG_AIC_GPAI_TEST=y
CONFIG_AIC_TSEN_TEST=y
CONFIG_AIC_PSADC_TEST=y
# ---- WiFi AP + socket(SAL) + FTP file service for ADAS ----
CONFIG_RT_USING_SAL=y
CONFIG_SAL_USING_LWIP=y
CONFIG_SO_REUSE=1
CONFIG_RT_LWIP_USING_PING=y
CONFIG_LWIP_USING_DHCPD=y
CONFIG_DHCPD_SERVER_IP="192.168.169.1"
CONFIG_LPKG_USING_AGILE_FTP=y
CONFIG_FTP_MAX_SESSION_NUM=4
CONFIG_FTP_SESSION_USERNAME="adas"
CONFIG_FTP_SESSION_PASSWORD="adas"
CONFIG_AGILE_FTP_AUTOSTART=y
CONFIG_AGILE_FTP_THREAD_STACK=4096
CONFIG_AGILE_FTP_THREAD_PRIO=20
CONFIG_LPKG_USING_NETUTILS=y
CONFIG_LPKG_NETUTILS_IPERF=y
CONFIG_LPKG_USING_RTT_AUTO_EXE_CMD=y
CONFIG_RTT_AUTO_INIT_TIME_MS=3000
CONFIG_RTT_CMD_1_STR="wifi -d mode ap wlan1"
CONFIG_RTT_CMD_1_DELAY=3000
CONFIG_RTT_CMD_2_STR="wifi ap ADAS_D133 adas123456"
CONFIG_RTT_CMD_2_DELAY=3000
CONFIG_RT_USING_POSIX_FS=y
CONFIG_RT_USING_POSIX_POLL=y
CONFIG_RT_USING_POSIX_SELECT=y
CONFIG_RT_USING_POSIX_SOCKET=y
# ---- dataServer: multi-threaded file server (NikosMav protocol), pull ADAS files ----
CONFIG_RT_USING_PTHREADS=y
CONFIG_LPKG_USING_DATASERVER=y
CONFIG_DATASERVER_PORT=9000
CONFIG_DATASERVER_POOL_SIZE=2
CONFIG_DATASERVER_QUEUE_SIZE=16
CONFIG_DATASERVER_BLOCK_SIZE=4096
CONFIG_DATASERVER_ROOT="/data/adas"
CONFIG_DATASERVER_THREAD_STACK=8192
CONFIG_DATASERVER_AUTOSTART=y
CONFIG_DATASERVER_STAT_PORT=9001
CONFIG_DATASERVER_LWIP_STATS=y
CONFIG_RT_LWIP_STATS=y
# ---- Ethernet(e0, RTL8201F RMII) <-> WiFi AP(w1) routing ----
CONFIG_AIC_USING_GMAC0=y
CONFIG_AIC_DEV_GMAC0_PHYRST_GPIO="PE.6"
CONFIG_AIC_DEV_GMAC0_RMII=y
CONFIG_AIC_DEV_GMAC0_PHY_EXTCLK=y
CONFIG_AIC_DEV_GMAC0_PHYADDR=1
CONFIG_AIC_DEV_GMAC0_IPADDR="192.168.1.1"
CONFIG_AIC_DEV_GMAC0_GW="192.168.1.1"
CONFIG_AIC_DEV_GMAC0_NETMASK="255.255.255.0"
CONFIG_AIC_USING_CLK_OUT2=y
CONFIG_AIC_CLK_OUT2_FREQ=25000000
# CONFIG_RT_LWIP_DHCP is not set
CONFIG_RT_LWIP_IPADDR="192.168.1.1"
CONFIG_RT_LWIP_GWADDR="192.168.1.1"
CONFIG_RT_LWIP_MSKADDR="255.255.255.0"
CONFIG_RT_LWIP_IP_FORWARD=y
```

## luban-lite/target/configs/d13x_nor-1024x600_rt-thread_helloworld_defconfig
```kconfig
CONFIG_PRJ_DEFCONFIG_FILENAME="d13x_nor-1024x600_rt-thread_helloworld_defconfig"
CONFIG_PRJ_CHIP="d13x"
CONFIG_PRJ_BOARD="nor-1024x600"
CONFIG_PRJ_KERNEL="rt-thread"
CONFIG_PRJ_APP="helloworld"
CONFIG_AIC_USING_FS_IMAGE_0=y
CONFIG_AIC_USING_FS_IMAGE_TYPE_FATFS_FOR_0=y
CONFIG_AIC_FS_IMAGE_DIR_0="rodata/"
CONFIG_AIC_FS_IMAGE_NAME_0="rodata.fatfs"
CONFIG_AIC_USING_FS_IMAGE_1=y
CONFIG_AIC_FS_IMAGE_DIR_1="data/"
CONFIG_AIC_FS_IMAGE_NAME_1="data.lfs"
CONFIG_LVGL_V_9=y
CONFIG_LPKG_LVGL_THREAD_STACK_SIZE=65536
CONFIG_AIC_LVGL_DEMO=y
CONFIG_HCN_D123BBV_DEMO=y
CONFIG_LV_COLOR_DEPTH=16
CONFIG_LV_CACHE_IMG_NUM=60
CONFIG_LV_CACHE_DEF_SIZE=0x1000000
CONFIG_AIC_USING_UART0=y
CONFIG_AIC_USING_UART2=y
CONFIG_AIC_DEV_UART2_MODE_RS232_AUTO_FLOW_CTRL=y
CONFIG_AIC_UART2_DMA_ENABLE_FLAG=y
CONFIG_AIC_USING_I2C0=y
CONFIG_AIC_USING_EPWM7=y
CONFIG_AIC_USING_CAN0=y
CONFIG_AIC_USING_QSPI0=y
CONFIG_AIC_QSPI0_DEVICE_SPINOR=y
CONFIG_AIC_USING_SDMC0=y
CONFIG_AIC_SDMC0_IS_SDIO=y
CONFIG_AIC_SDMC0_CLK_FREQ=40000000
CONFIG_AIC_WIRELESS_LAN=y
CONFIG_AIC_WIRELESS_PWR_GPIO="PD.3"
CONFIG_AIC_WLAN_AIC8800D40L=y
CONFIG_CONFIG_AIC8800_BT_SUPPORT=y
# CONFIG_AIC_DEV_AIC8800_DEBUG_LOG is not set
CONFIG_AIC_USING_TSEN=y
CONFIG_AIC_USING_TSEN_CPU=y
CONFIG_AIC_USING_TSEN_GPAI=y
CONFIG_AIC_USING_GPAI=y
CONFIG_AIC_DISP_LVDS=y
CONFIG_AICFB_RGB565=y
CONFIG_AIC_PAN_DISPLAY=y
# CONFIG_AIC_DISP_BOOTUP_LOGO is not set
CONFIG_AIC_PANEL_ENABLE_GPIO="PD.14"
CONFIG_AIC_GE_CMDQ=y
CONFIG_AIC_USING_DMA=y
CONFIG_AIC_USING_WRI=y
CONFIG_AIC_USING_RTC=y
CONFIG_AIC_USING_WDT=y
CONFIG_AIC_PSRAM_SIZE=0x2000000
CONFIG_AIC_PSRAM_SW_SIZE=0x0800000
CONFIG_AIC_SEC_DATA_SRAM_S0=y
CONFIG_AIC_INTERRUPTSTACK_SIZE=4096
CONFIG_AIC_CLK_PLL_FRA0_FREQ=792000000
CONFIG_AIC_CLK_PLL_FRA2_FREQ=1188000000
CONFIG_AIC_USING_SID=y
CONFIG_AIC_SYSCFG_LDO1X_ENABLE=y
CONFIG_AIC_SYSCFG_LDO1X_VOL_VAL=8
CONFIG_AIC_USING_MTOP=y
CONFIG_AIC_USING_PSADC=y
CONFIG_AIC_PSADC_DRV_POLL=y
CONFIG_AIC_USING_PSADC6=y
CONFIG_AIC_USING_PSADC7=y
CONFIG_IDLE_THREAD_STACK_SIZE=1024
CONFIG_RT_TIMER_THREAD_PRIO=7
CONFIG_RT_TIMER_THREAD_STACK_SIZE=8192
# CONFIG_RT_KSERVICE_USING_STDLIB is not set
# CONFIG_RT_DEBUG is not set
CONFIG_RT_MEMHEAP_BSET_MODE=y
CONFIG_RT_USING_MEMHEAP_AS_HEAP=y
# CONFIG_RT_USING_MEMHEAP_AUTO_BINDING is not set
CONFIG_RT_CONSOLE_DEVICE_NAME="uart0"
CONFIG_RT_MAIN_THREAD_STACK_SIZE=4096
CONFIG_FINSH_HISTORY_LINES=1
CONFIG_DFS_FILESYSTEMS_MAX=8
CONFIG_RT_USING_DFS_MNTTABLE=y
CONFIG_RT_USING_DFS_ELMFAT=y
CONFIG_RT_DFS_ELM_LFN_UNICODE_2=y
CONFIG_RT_DFS_ELM_USE_EXFAT=y
CONFIG_RT_DFS_ELM_DRIVES=4
CONFIG_RT_DFS_ELM_MAX_SECTOR_SIZE=4096
CONFIG_RT_USING_DFS_ROMFS=y
CONFIG_RT_USING_FAL=y
# CONFIG_FAL_DEBUG_CONFIG is not set
CONFIG_FAL_USING_SFUD_PORT=y
# CONFIG_FAL_BLK_DEVICE_RDONLY is not set
CONFIG_RT_USING_SYSTEM_WORKQUEUE=y
CONFIG_RT_SYSTEM_WORKQUEUE_STACKSIZE=8192
CONFIG_RT_USING_PM=y
CONFIG_PM_USING_CUSTOM_CONFIG=y
CONFIG_PM_ENABLE_SUSPEND_SLEEP_MODE=y
CONFIG_PM_ENABLE_THRESHOLD_SLEEP_MODE=y
CONFIG_RT_SDIO_STACK_SIZE=16384
CONFIG_RT_SDIO_THREAD_PRIORITY=5
CONFIG_RT_MMCSD_STACK_SIZE=8192
CONFIG_RT_SFUD_USING_QSPI=y
CONFIG_RT_USING_WIFI=y
CONFIG_RT_WLAN_WORKQUEUE_THREAD_SIZE=8192
CONFIG_RT_USING_NETDEV=y
CONFIG_RT_LWIP_TCPTHREAD_PRIORITY=3
CONFIG_RT_LWIP_TCPTHREAD_STACKSIZE=8192
CONFIG_RT_LWIP_REASSEMBLY_FRAG=y
CONFIG_RT_LWIP_NETIF_LOOPBACK=y
CONFIG_RT_USING_ULOG=y
CONFIG_ULOG_OUTPUT_LVL_I=y
CONFIG_ULOG_TIME_USING_TIMESTAMP=y
CONFIG_ULOG_USING_FILTER=y
CONFIG_LPKG_USING_CPU_USAGE=y
CONFIG_LPKG_USING_LITTLEFS=y
CONFIG_LPKG_USING_FREETYPE=y
CONFIG_AIC_MPP_PLAYER_INTERFACE=y
CONFIG_AIC_MPP_PLAYER_VIDEO_EXT_RENDER=y
CONFIG_AIC_GPIO_IRQ_DRV_EN=y
CONFIG_AIC_CMU_DRV_TEST=y
CONFIG_AIC_GPIO_DRV_TEST=y
CONFIG_AIC_DMA_DRV_TEST=y
CONFIG_AIC_CAN_DRV_TEST=y
CONFIG_AIC_AUDIO_DRV_TEST=y
CONFIG_AIC_GPAI_TEST=y
CONFIG_AIC_TSEN_TEST=y
CONFIG_AIC_PSADC_TEST=y
```
