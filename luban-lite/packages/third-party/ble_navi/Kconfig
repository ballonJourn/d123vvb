## luban-lite/packages/third-party/ble_navi/Kconfig
```kconfig
menuconfig LPKG_USING_BLE_NAVI
    bool "BLE Navi: BLE GATT image/navigation receiver (BNP + Chronos compat)"
    default n
    depends on !LPKG_USING_BLENAVI
    select AIC_GE_DRV
    help
      D133 as BLE peripheral: receives navigation frames (JPEG/RGB565/1bpp icon)
      and route text from a phone/PC, shows them via VE+GE.
      Protocol: firmware/ble_navi/bnp_proto.h

if LPKG_USING_BLE_NAVI

choice
    prompt "BLE host backend"
    default BLE_NAVI_BACKEND_NIMBLE

config BLE_NAVI_BACKEND_NIMBLE
    bool "NimBLE host (vendor local package packages/third-party/nimble) over HCI UART"
    depends on CONFIG_AIC8800_BT_SUPPORT
    select LPKG_USING_NIMBLE
    select LPKG_NIMBLE_ROLE_PERIPHERAL
    select LPKG_NIMBLE_HOST
    select LPKG_NIMBLE_HCI_USING_RTT_UART
    help
      Uses the ArtInChip NimBLE local package (H4, 1.5 Mbps, HW auto flow
      control in its rtthread transport) and the AIC8800 driver's aicbt_init
      (enabled by CONFIG_AIC8800_BT_SUPPORT) which loads the BT patch over SDIO
      and puts BT on UART. Set UART2 to RS232_AUTO_FLOW_CTRL, 1500000 baud.
      Keep LPKG_NIMBLE_CTLR off. LPKG_NIMBLE_HCI_H4 and
      LPKG_NIMBLE_SAMPLE_DISABLE are choice members: Kconfig cannot select
      them, so they are set in the board defconfig.

endchoice

config BLE_NAVI_DEV_NAME
    string "Advertised device name"
    default "D133-Navi"

config BLE_NAVI_PREF_MTU
    int "Preferred ATT MTU"
    range 23 517
    default 247

config BLE_NAVI_CONN_INTERVAL_MS
    int "Requested connection interval (ms)"
    range 8 100
    default 15

config BLE_NAVI_CONN_CE_FULL
    bool "Request full-length connection events (max_ce_len 0xFFFF)"
    default y
    help
      Put in the connection parameter request. esp-idf's NimBLE
      throughput_app does the same (its comment: use the entire connection
      interval); NimBLE's own default is 0. Whether the AIC8800 controller
      honours it is unknown: switch off to compare.

config BLE_NAVI_LINK_TUNE_DELAY_MS
    int "Wait after connect before PHY / connection parameter requests (ms)"
    range 0 10000
    default 2000
    help
      Phones start their own link procedures right after connecting. Our
      2M PHY and connection parameter requests are sent after this delay
      and one after the other. 0 = immediately (the old behaviour, which
      dropped Android links with HCI 0x08 connection timeout).

config BLE_NAVI_MAX_FRAME_BYTES
    int "Largest accepted frame (bytes, CMA)"
    default 1228800
    help
      demo88 panel 1024x600 RGB565 = 1228800 (CMA, PSRAM). JPEG frames are
      typically 30-80 KB: prefer JPEG, raw full screens take 10+ s over BLE.

config BLE_NAVI_CHRONOS_COMPAT
    bool "Chronos app compatibility (NUS service, nav text + 48x48 icon)"
    default y

config BLE_NAVI_TURN_X
    int "Turn icon X"
    default 16
config BLE_NAVI_TURN_Y
    int "Turn icon Y"
    default 16
config BLE_NAVI_TURN_SCALE
    int "Turn icon scale (48px * N)"
    range 1 4
    default 2

config BLE_NAVI_DISP_LVGL
    bool "Show pictures through LVGL (lv_layer_top), not straight on the framebuffer"
    default y
    depends on LPKG_USING_LVGL && LVGL_V_9
    help
      Needed when the application runs LVGL: LVGL owns the framebuffer and
      uses the VE itself ("lv_mpp_dec_open: Invalid status" otherwise).
      Pictures are decoded in the LVGL thread and shown as an lv_image on the
      top layer. The application must call ble_navi_lv_attach() once from the
      LVGL thread; packages/artinchip/lvgl-ui/lv_demo.c does it in
      lv_user_gui_init().

config BLE_NAVI_ERYA
    bool "尔雅 BLE 导航协议 Ver 1.2 (领骑摩托 app: 0xAAA1..0xAAAA, EY/EB frames)"
    default y
    help
      GATT service with characteristics 0xAAA1..0xAAAA. The device name becomes
      <prefix><BT MAC>, AAA5 carries "<MAC>&<model key>", the app sends JPEG
      pictures on AAA7 and navigation JSON on AAA8.
      Needs cJSON: the helloworld application already builds one
      (application/rt-thread/helloworld/third/json). Do not also enable
      LPKG_USING_CJSON there, both would define the same symbols.

if BLE_NAVI_ERYA

config BLE_NAVI_ERYA_SVC_UUID
    hex "Primary service UUID (16-bit)"
    default 0xAAA0
    help
      The protocol document lists the characteristics 0xAAA1..0xAAAA only, not
      the service UUID. Change it if the app does not find the characteristics.

config BLE_NAVI_ERYA_NAME_PREFIX
    string "Device name prefix (name = prefix + MAC)"
    default "EY_"

config BLE_NAVI_ERYA_MODEL_KEY
    string "车型 key (issued by 尔雅 after the business agreement)"
    default ""

config BLE_NAVI_ERYA_PIC_W
    int "Requested picture width"
    default 480
    help
      Asked from the phone in AAA6. The decoded picture is kept in CMA
      (w x h x 2 bytes); on demo88 CMA is ~3.9 MB with ~2.4 MB taken by the
      framebuffers, so 800x480 (750 KB) starves the LVGL UI. 480x288
      (270 KB) is stretched to BLE_NAVI_ERYA_DISP_W x _H on screen.
config BLE_NAVI_ERYA_PIC_H
    int "Requested picture height"
    default 288
config BLE_NAVI_ERYA_PIC_Q
    int "Requested picture quality (120..200, ratio = value - 100)"
    range 120 200
    default 160
config BLE_NAVI_ERYA_PIC_TYPE
    string "Requested JPEG sampling (420 or 422)"
    default "420"

config BLE_NAVI_ERYA_DISP_X
    int "Picture X on screen"
    default 112
config BLE_NAVI_ERYA_DISP_Y
    int "Picture Y on screen"
    default 60
config BLE_NAVI_ERYA_DISP_W
    int "Picture width on screen (0 = as received)"
    default 800
config BLE_NAVI_ERYA_DISP_H
    int "Picture height on screen (0 = as received)"
    default 480

config BLE_NAVI_ERYA_LOG
    bool "Log every protocol step on the console (reads, writes, notifies, pictures)"
    default y

config BLE_NAVI_ERYA_MAX_PIC_BYTES
    int "Largest accepted picture (bytes)"
    default 524288

endif

endif
```

## luban-lite/packages/third-party/blenavi/Kconfig
```kconfig
# blenavi: BLE navigation receiver for D133 (chronos-esp32 + BNP image service)
menuconfig LPKG_USING_BLENAVI
    bool "blenavi: BLE navigation receiver (Chronos app + BNP image frames)"
    depends on CONFIG_AIC8800_BT_SUPPORT
    select LPKG_USING_NIMBLE
    select LPKG_NIMBLE_ROLE_PERIPHERAL
    select LPKG_NIMBLE_HOST
    select LPKG_NIMBLE_HCI_USING_RTT_UART
    select LPKG_NIMBLE_HCI_H4
    select LPKG_USING_FREERTOS_WRAPPER
    select RT_USING_CPLUSPLUS
    select AIC_GE_DRV
    default n
    help
      Runs fbiego/chronos-esp32 (unmodified) on h2zero/esp-nimble-cpp 2.6.0
      (unmodified) over the vendor NimBLE (packages/third-party/nimble) and
      the AIC8800 BT core (aicbt_init, CONFIG_AIC8800_BT_SUPPORT), plus a BNP
      image service on the same server. Frames go to VE/GE via disp_sink.
      Needs UART2 = RS232_AUTO_FLOW_CTRL at 1500000 and
      LPKG_NIMBLE_SAMPLE_DISABLE (esp-nimble-cpp starts the host thread).
      See D133-CHANGES.md.

if LPKG_USING_BLENAVI
    config BLENAVI_DEV_NAME
        string "Advertised device name"
        default "D133-Navi"

    config BLENAVI_MAX_FRAME_BYTES
        int "Largest BNP frame (bytes, CMA)"
        default 1228800
        help
          demo88 panel 1024x600 RGB565 = 1228800. JPEG frames are far smaller.

    config BLENAVI_CONN_INTERVAL_MS
        int "Requested connection interval (ms)"
        range 8 100
        default 15

    config BLENAVI_TURN_X
        int "Turn icon X"
        default 16
    config BLENAVI_TURN_Y
        int "Turn icon Y"
        default 16
    config BLENAVI_TURN_SCALE
        int "Turn icon scale (48 px * N)"
        range 1 4
        default 2

    config BLENAVI_AUTOSTART
        bool "Start at boot"
        default n
endif
```

## luban-lite/target/configs/d13x_nor-1024x600_rt-thread_helloworld_defconfig
```kconfig
CONFIG_PRJ_DEFCONFIG_FILENAME="d13x_nor-1024x600_rt-thread_helloworld_defconfig"
CONFIG_PRJ_CHIP="d13x"
CONFIG_PRJ_BOARD="nor-1024x600"
CONFIG_PRJ_KERNEL="rt-thread"
CONFIG_PRJ_APP="helloworld"
CONFIG_AIC_USING_FS_IMAGE_0=y
CONFIG_AIC_USING_FS_IMAGE_TYPE_FATFS_FOR_0=y
CONFIG_AIC_FS_IMAGE_DIR_0="rodata/"
CONFIG_AIC_FS_IMAGE_NAME_0="rodata.fatfs"
CONFIG_AIC_USING_FS_IMAGE_1=y
CONFIG_AIC_FS_IMAGE_DIR_1="data/"
CONFIG_AIC_FS_IMAGE_NAME_1="data.lfs"
CONFIG_LVGL_V_9=y
CONFIG_LPKG_LVGL_THREAD_STACK_SIZE=65536
CONFIG_AIC_LVGL_DEMO=y
CONFIG_HCN_D123BBV_DEMO=y
CONFIG_LV_COLOR_DEPTH=16
CONFIG_LV_CACHE_IMG_NUM=60
CONFIG_LV_CACHE_DEF_SIZE=0x1000000
CONFIG_AIC_USING_UART0=y
CONFIG_AIC_USING_UART2=y
CONFIG_AIC_DEV_UART2_MODE_RS232_AUTO_FLOW_CTRL=y
# UART2 DMA off: the NimBLE H4 path was verified on demo88 without it
# CONFIG_AIC_UART2_DMA_ENABLE_FLAG is not set
CONFIG_AIC_DEV_UART2_BAUDRATE=1500000
CONFIG_AIC_USING_I2C0=y
CONFIG_AIC_USING_EPWM7=y
CONFIG_AIC_USING_CAN0=y
CONFIG_AIC_USING_USB0=y
CONFIG_AIC_USING_USB0_HOST=y
CONFIG_AIC_USING_QSPI0=y
CONFIG_AIC_QSPI0_DEVICE_SPINOR=y
CONFIG_AIC_USING_SDMC0=y
# CONFIG_AIC_USING_SDMC1 is not set
CONFIG_AIC_SDMC0_IS_SDIO=y
CONFIG_AIC_SDMC0_CLK_FREQ=40000000
CONFIG_AIC_WIRELESS_LAN=y
CONFIG_AIC_WIRELESS_PWR_GPIO="PD.3"
CONFIG_AIC_WLAN_AIC8800D40L=y
CONFIG_CONFIG_AIC8800_BT_SUPPORT=y
# CONFIG_AIC_DEV_AIC8800_DEBUG_LOG is not set
CONFIG_AIC_USING_TSEN=y
CONFIG_AIC_USING_TSEN_CPU=y
CONFIG_AIC_USING_TSEN_GPAI=y
CONFIG_AIC_USING_GPAI=y
CONFIG_AIC_DISP_LVDS=y
CONFIG_AICFB_RGB565=y
CONFIG_AIC_PAN_DISPLAY=y
# CONFIG_AIC_DISP_BOOTUP_LOGO is not set
CONFIG_AIC_PANEL_ENABLE_GPIO="PD.14"
CONFIG_AIC_GE_CMDQ=y
CONFIG_AIC_USING_DMA=y
CONFIG_AIC_USING_WRI=y
CONFIG_AIC_USING_RTC=y
CONFIG_AIC_USING_WDT=y
CONFIG_AIC_PSRAM_SIZE=0x2000000
CONFIG_AIC_PSRAM_SW_SIZE=0x0800000
CONFIG_AIC_SEC_DATA_SRAM_S0=y
CONFIG_AIC_INTERRUPTSTACK_SIZE=4096
CONFIG_AIC_CLK_PLL_FRA0_FREQ=792000000
CONFIG_AIC_CLK_PLL_FRA2_FREQ=1188000000
CONFIG_AIC_USING_PM=y
CONFIG_AIC_PM_POWER_DEFAULT_LIGHT_MODE=y
CONFIG_AIC_USING_SID=y
CONFIG_AIC_SYSCFG_LDO1X_ENABLE=y
CONFIG_AIC_SYSCFG_LDO1X_VOL_VAL=8
CONFIG_AIC_USING_MTOP=y
CONFIG_AIC_USING_PSADC=y
CONFIG_AIC_PSADC_DRV_POLL=y
CONFIG_AIC_USING_PSADC6=y
CONFIG_AIC_USING_PSADC7=y
CONFIG_IDLE_THREAD_STACK_SIZE=1024
CONFIG_RT_TIMER_THREAD_PRIO=7
CONFIG_RT_TIMER_THREAD_STACK_SIZE=8192
# CONFIG_RT_KSERVICE_USING_STDLIB is not set
# CONFIG_RT_DEBUG is not set
CONFIG_RT_MEMHEAP_BSET_MODE=y
CONFIG_RT_USING_MEMHEAP_AS_HEAP=y
# CONFIG_RT_USING_MEMHEAP_AUTO_BINDING is not set
CONFIG_RT_USING_HEAP_ISR=y
CONFIG_RT_CONSOLE_DEVICE_NAME="uart0"
CONFIG_RT_MAIN_THREAD_STACK_SIZE=4096
CONFIG_FINSH_HISTORY_LINES=1
CONFIG_DFS_FILESYSTEMS_MAX=8
CONFIG_RT_USING_DFS_MNTTABLE=y
CONFIG_RT_USING_DFS_ELMFAT=y
CONFIG_RT_DFS_ELM_LFN_UNICODE_2=y
CONFIG_RT_DFS_ELM_USE_EXFAT=y
CONFIG_RT_DFS_ELM_DRIVES=4
CONFIG_RT_DFS_ELM_MAX_SECTOR_SIZE=4096
CONFIG_RT_USING_DFS_ROMFS=y
CONFIG_RT_USING_FAL=y
# CONFIG_FAL_DEBUG_CONFIG is not set
CONFIG_FAL_USING_SFUD_PORT=y
# CONFIG_FAL_BLK_DEVICE_RDONLY is not set
CONFIG_RT_USING_SYSTEM_WORKQUEUE=y
CONFIG_RT_SYSTEM_WORKQUEUE_STACKSIZE=8192
CONFIG_RT_SDIO_STACK_SIZE=16384
CONFIG_RT_SDIO_THREAD_PRIORITY=5
CONFIG_RT_MMCSD_STACK_SIZE=8192
CONFIG_RT_SFUD_USING_QSPI=y
CONFIG_RT_USING_WIFI=y
CONFIG_RT_WLAN_WORKQUEUE_THREAD_SIZE=8192
CONFIG_RT_USING_NETDEV=y
CONFIG_RT_LWIP_TCPTHREAD_PRIORITY=3
CONFIG_RT_LWIP_TCPTHREAD_STACKSIZE=8192
CONFIG_RT_LWIP_REASSEMBLY_FRAG=y
CONFIG_RT_LWIP_NETIF_LOOPBACK=y
CONFIG_RT_USING_ULOG=y
CONFIG_ULOG_OUTPUT_LVL_I=y
CONFIG_ULOG_TIME_USING_TIMESTAMP=y
CONFIG_ULOG_USING_FILTER=y
CONFIG_LPKG_USING_CPU_USAGE=y
CONFIG_LPKG_USING_CHERRYUSB=y
CONFIG_LPKG_CHERRYUSB_HOST=y
CONFIG_LPKG_CHERRYUSB_HOST_MSC=y
CONFIG_LPKG_CHERRYUSB_THIRD_PARTY=y
CONFIG_LPKG_CHERRYUSB_MEMORY_POOL=y
CONFIG_LPKG_CHERRYUSB_RINGBUFFER=y
CONFIG_LPKG_USING_LITTLEFS=y
CONFIG_LPKG_USING_FREETYPE=y
CONFIG_AIC_MPP_PLAYER_INTERFACE=y
CONFIG_AIC_MPP_PLAYER_VIDEO_EXT_RENDER=y
CONFIG_AIC_GPIO_IRQ_DRV_EN=y
CONFIG_AIC_CMU_DRV_TEST=y
CONFIG_AIC_GPIO_DRV_TEST=y
CONFIG_AIC_DMA_DRV_TEST=y
CONFIG_AIC_CAN_DRV_TEST=y
CONFIG_AIC_AUDIO_DRV_TEST=y
CONFIG_AIC_GPAI_TEST=y
CONFIG_AIC_TSEN_TEST=y
CONFIG_AIC_PSADC_TEST=y

# ---- BLE navi image receiver (from d133bleNavi, demo88 verified) ----
# BT controller: AIC8800 on UART2 PD.4/PD.5, HW flow PA.2/PA.3, patch loaded by
# aicbt_init during WiFi init (brought up by mw/bt_module/ble_navi_byd.c).
# No AIC_DEV_AIC8800_BT_RST_GPIO: demo88 uses PD.6, which is USB5V on this board.
# Replaces the GOC BT stack (and Bluetooth TPMS) while enabled, see dev_config.h.
CONFIG_LPKG_USING_NIMBLE=y
CONFIG_LPKG_NIMBLE_HCI_USING_RTT_UART=y
CONFIG_LPKG_NIMBLE_HCI_UART_DEVICE_NAME="uart2"
CONFIG_LPKG_NIMBLE_HCI_H4=y
CONFIG_LPKG_NIMBLE_HOST_THREAD_STACK_SIZE=4096
CONFIG_LPKG_NIMBLE_SAMPLE_DISABLE=y
CONFIG_LPKG_USING_BLE_NAVI=y
CONFIG_BLE_NAVI_BACKEND_NIMBLE=y
# hci_uart_rx above LVGL (20) so the 1.5 Mbps HCI uart never overflows during UI work
CONFIG_LPKG_NIMBLE_HCI_UART_RX_THREAD_PRIORITY=9
CONFIG_LPKG_NIMBLE_HCI_UART_RX_BUFSZ=4096
# 尔雅 debug model key (debug phase only; replace with the production key before release)
CONFIG_BLE_NAVI_ERYA_MODEL_KEY="EYMOTOR12FCB99FD224DB2B22F5A7703"
# device code already activated in the 尔雅 app (AAA5 and the name EY_<code>)
CONFIG_BLE_NAVI_ERYA_DEVICE_ID="CCC4V2V64DA0"
# link parameters as the last demo88 A/B test (2026-11-20)
# CONFIG_BLE_NAVI_CONN_CE_FULL is not set
# CONFIG_BLE_NAVI_CONN_L2CAP_FALLBACK is not set
CONFIG_BLE_NAVI_CONN_INTERVAL_MIN_MS=0
# ask for the largest ATT MTU; the phone decides (log: "ATT MTU n -> chunk")
CONFIG_BLE_NAVI_PREF_MTU=517
```
